## boards/shields/ergonaut_one/Kconfig
```kconfig
source "boards/shields/ergonaut_one/Kconfig.shield"
source "boards/shields/ergonaut_one/Kconfig.defconfig"
```

## boards/shields/ergonaut_one/Kconfig.defconfig
```kconfig
if SHIELD_ERGONAUT_ONE_LEFT || SHIELD_ERGONAUT_ONE_RIGHT

config ZMK_KEYBOARD_NAME
    default "Ergonaut One"

config ZMK_SPLIT
    default y

endif
```

## boards/shields/ergonaut_one/Kconfig.shield
```kconfig
config SHIELD_ERGONAUT_ONE_LEFT
    def_bool $(shields_list_contains,ergonaut_one_left)

config SHIELD_ERGONAUT_ONE_RIGHT
    def_bool $(shields_list_contains,ergonaut_one_right)
```

## config/west.yml
```yaml
manifest:
  remotes:
    - name: zmkfirmware
      url-base: https://github.com
    - name: ergonautkb
      url-base: https://github.com
  projects:
    - name: zmk
      remote: zmkfirmware
      revision: main
      import: app/west.yml
    - name: ergonautkb-zmk-module
      remote: ergonautkb
      revision: main
  self:
    path: config
```
